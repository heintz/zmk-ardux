## config/boards/shields/corne_left/Kconfig.defconfig
```kconfig
if SHIELD_CORNE_ARDUX_LEFT || SHIELD_CORNE_5_COL_ARDUX_LEFT || SHIELD_CORNE_5_COL_ARDUX_LEFT_BIG

config ZMK_KEYBOARD_NAME
	default "ARDUX L"

config I2C
	default y

config SSD1306
	default y

config LV_Z_VDB_SIZE
	default 64

config LV_DPI_DEF
	default 148

config LV_Z_BITS_PER_PIXEL
	default 1

choice LV_COLOR_DEPTH
	default LV_COLOR_DEPTH_1
endchoice

endif
```

## config/boards/shields/tidbit_ardux_left/Kconfig.defconfig
```kconfig
# Copyright (c) 2021 Mike "KemoNine" Crosson
# SPDX-License-Identifier: MIT

if SHIELD_TIDBIT_ARDUX_LEFT

config ZMK_KEYBOARD_NAME
	default "ARDUX Tidbit L"

config I2C
	default y

config SSD1306
	default y

config LV_Z_VDB_SIZE
	default 64

config LV_DPI_DEF
	default 148

config LV_Z_BITS_PER_PIXEL
	default 1

choice LV_COLOR_DEPTH
	default LV_COLOR_DEPTH_1
endchoice

endif
```
